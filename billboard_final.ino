#include "DHT.h"
#define  DHTPIN D4 
#include "DHT.h"
#define DHTPIN D4 
#define DHTTYPE DHT11   // DHT 11
#include <Adafruit_GFX.h>
#include <Adafruit_SPITFT.h>
#include <gfxfont.h>
#include <ESP8266WiFi.h>
#include <PubSubClient.h>
#include <SPI.h>
#include <Wire.h>
#include <Adafruit_GFX.h>
#include <Adafruit_SSD1306.h>

const char* ssid = "Redmi";
const char* password = "durgarajdd";

#define ORG "2soh8t"
#define DEVICE_TYPE "sovereigns"
#define DEVICE_ID "abcd"
#define TOKEN "abcde123"
String command;
char server[] = ORG ".messaging.internetofthings.ibmcloud.com";
char topic[] = "iot-2/cmd/home/fmt/String";
char authMethod[] = "use-token-auth";
char token[] = TOKEN;
char clientId[] = "d:" ORG ":" DEVICE_TYPE ":" DEVICE_ID;
//Serial.println(clientID);
#define OLED_RESET D5
void drawStr(uint8_t x, uint8_t y, char* str);
/* Object named display, of the class Adafruit_SSD1306 */
Adafruit_SSD1306 display(OLED_RESET);

#if (SSD1306_LCDHEIGHT != 64)
//#error("Height incorrect, please fix Adafruit_SSD1306.h!");
#endif
char k[30],s[40];
DHT dht(DHTPIN, DHTTYPE);

WiFiClient wifiClient;
void callback(char* topic, byte* payload, unsigned int payloadLength);
PubSubClient client(server, 1883, callback, wifiClient);
// 'aits new cropped', 128x64px
const unsigned char myBitmap1 [] PROGMEM = {
  0xff, 0xff, 0xff, 0xff, 0xff, 0xff, 0xfe, 0x00, 0x00, 0x7f, 0xff, 0xff, 0xff, 0xff, 0xff, 0xff, 
  0xff, 0xff, 0xff, 0xff, 0xff, 0xf8, 0x00, 0x00, 0x00, 0x00, 0x1f, 0xff, 0xff, 0xff, 0xff, 0xff, 
  0xff, 0xff, 0xff, 0xff, 0xff, 0x00, 0x01, 0xe3, 0x64, 0xc6, 0x00, 0xff, 0xff, 0xff, 0xff, 0xff, 
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  0xff, 0xff, 0xff, 0xff, 0xff, 0xff, 0xfe, 0x00, 0x00, 0x7f, 0xff, 0xff, 0xff, 0xff, 0xff, 0xff
};
// 'cocola image new cropped', 128x64px
const unsigned char myBitmap2 [] PROGMEM = {
  0xff, 0xff, 0xff, 0xff, 0xff, 0xff, 0xff, 0xff, 0xff, 0xff, 0xff, 0xff, 0xff, 0xff, 0xff, 0xff, 
  0xff, 0xff, 0xff, 0xff, 0xff, 0xff, 0xff, 0xff, 0xff, 0xff, 0xff, 0xff, 0xff, 0xff, 0xff, 0xff, 
  0xff, 0xff, 0xff, 0xff, 0xff, 0xff, 0xff, 0xff, 0xff, 0xff, 0xff, 0xff, 0xff, 0xff, 0xff, 0xff, 
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  0xff, 0xff, 0xff, 0xff, 0xff, 0xff, 0xff, 0xff, 0xff, 0xff, 0xff, 0xff, 0xff, 0xff, 0xff, 0xff
};
// 'galaxy new cropped', 128x64px
const unsigned char myBitmap3 [] PROGMEM = {
  0x00, 0x00, 0x00, 0x00, 0x00, 0x00, 0x00, 0x00, 0x00, 0x00, 0x00, 0x00, 0x00, 0x00, 0x00, 0x00, 
  0x00, 0x00, 0x00, 0x00, 0x00, 0x00, 0x00, 0x00, 0x00, 0x00, 0x00, 0x00, 0x00, 0x00, 0x00, 0x00, 
  0x00, 0x00, 0x00, 0x00, 0x00, 0x07, 0x80, 0x00, 0x00, 0x00, 0x00, 0x00, 0x00, 0x00, 0x00, 0x00, 
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  0x00, 0x00, 0x00, 0x00, 0x00, 0x00, 0x00, 0x00, 0x00, 0x07, 0x00, 0x00, 0x1f, 0x80, 0x00, 0x00
};
// 'smart1 new cropped', 128x64px
const unsigned char myBitmap4 [] PROGMEM = {
  0x00, 0x00, 0x00, 0x00, 0x00, 0x00, 0x00, 0x00, 0x00, 0x00, 0x00, 0x00, 0x00, 0x00, 0x00, 0x00, 
  0x00, 0x00, 0x00, 0x00, 0x00, 0x00, 0x00, 0x00, 0x00, 0x00, 0x00, 0x00, 0x00, 0x00, 0x00, 0x00, 
  0x00, 0x00, 0x00, 0x00, 0x00, 0x00, 0x00, 0x00, 0x00, 0x00, 0x00, 0x00, 0x00, 0x00, 0x00, 0x00, 
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  0x00, 0x00, 0x00, 0x00, 0x00, 0x00, 0x00, 0x00, 0x00, 0x00, 0x00, 0x00, 0x00, 0x00, 0x00, 0x00
};




void setup() {
  display.clearDisplay();  
   Serial.begin(9600);
  Serial.println("DHTxx test!");

  dht.begin();
  
  display.begin(SSD1306_SWITCHCAPVCC, 0x3C); /* Initialize display with address 0x3C */
  display.clearDisplay(); 

   display.setTextSize(1);  /* Select font size of text. Increases with size of argument. */
  display.setTextColor(WHITE);  /* Color of text*/
  
  Serial.begin(115200);
  Serial.println();
 // pinMode(D1,OUTPUT);

  wifiConnect();
  mqttConnect();
}

void loop() {
  {
    display.clearDisplay();  
    delay(2000);
  // Reading temperature or humidity takes about 250 milliseconds!
  // Sensor readings may also be up to 2 seconds 'old' (its a very slow sensor)
  int h = dht.readHumidity();
  // Read temperature as Celsius (the default)
  int t = dht.readTemperature();
  // Check if any reads failed and exit early (to try again).
  if (isnan(h) || isnan(t)) {
    Serial.println("Failed to read from DHT sensor!");
    return;
  }
 

}



  if (!client.loop()) {
    mqttConnect();
  }
delay(100);
}

void wifiConnect() {
  Serial.print("Connecting to "); Serial.print(ssid);
  WiFi.begin(ssid, password);
  while (WiFi.status() != WL_CONNECTED) {
    delay(500);
    Serial.print(".");
  }
  Serial.print("nWiFi connected, IP address: "); Serial.println(WiFi.localIP());
}

void mqttConnect() {
  if (!client.connected()) {
    Serial.print("Reconnecting MQTT client to "); Serial.println(server);
    while (!client.connect(clientId, authMethod, token)) {
      Serial.print(".");
      delay(500);
    }
    initManagedDevice();
    Serial.println();
  }
}
void initManagedDevice() {
  if (client.subscribe(topic)) {
    Serial.println("subscribe to cmd OK");
  } else {
    Serial.println("subscribe to cmd FAILED");
  }
}
void drawStr(uint8_t x, uint8_t y, char* str){
  display.setCursor(x, y);  // Set x,y coordinates 
  display.println(str);
}

void callback(char* topic, byte* payload, unsigned int payloadLength) {
  Serial.print("callback invoked for topic: "); Serial.println(topic);

  for (int i = 0; i < payloadLength; i++) {
    //Serial.println((char)payload[i]);
    command += (char)payload[i];
  }
Serial.println(command);
 int h = dht.readHumidity();
int t = dht.readTemperature();
if(t >20)
{ 
  drawStr(0,20,"temperature is high");
  display.display();
   delay(5000);
   display.clearDisplay();  
   Serial.print("Humidity: ");
  Serial.print(h);
  Serial.print(" %\t");
  Serial.print("Temperature: ");
  Serial.print(t);
  Serial.println(" *C ");
  sprintf(k, "Humidity: %d", h);
  sprintf(s, "Temperature: %d", t);
 drawStr(0, 0,k);
 drawStr(0,10,s);
display.display();
delay(5000);
  display.clearDisplay();  
  }
else if(t<20)
{  Serial.print("Humidity: ");
  Serial.print(h);
  Serial.print(" %\t");
  Serial.print("Temperature: ");
  Serial.print(t);
  Serial.println(" *C ");
  sprintf(k, "Humidity: %d", h);
  sprintf(s, "Temperature: %d", t);
                                                                                                                                                                                                                                                                                                                            drawStr(0, 0,k);
 drawStr(0,10,s);
display.display();
}
display.clearDisplay();
if(command == "A1"){
  display.clearDisplay();
   display.drawBitmap(0, 0,  myBitmap1, 128, 64, BLACK, WHITE);
   display.display();
   delay(2000);
  //display.clearDisplay();
}
if(command == "A2"){
  display.clearDisplay();
 display.drawBitmap(0, 0,  myBitmap2, 128, 64, BLACK, WHITE);
   display.display();
   delay(2000);
 // display.clearDisplay();
}
if(command == "A3"){
  display.clearDisplay();
 display.drawBitmap(0, 0,  myBitmap3, 128, 64, BLACK, WHITE);
  display.display();
  delay(2000);
   //display.clearDisplay();
}
 if(command == "A4"){
  display.clearDisplay();
 display.drawBitmap(0, 0,  myBitmap4, 128, 64, BLACK, WHITE);
  display.display();
  delay(2000);
   //display.clearDisplay();
}
/*if(command == "ALLON"){
  digitalWrite(D1,HIGH);
  digitalWrite(D2,LOW);
  Serial.println("Light is Switched ON");
}
else if(command == "ALLOFF"){
  digitalWrite(D1,LOW);
  digitalWrite(D2,HIGH);
  Serial.println("Light is Switched OFF");
} */
// Length (with one extra character for the null terminator)
int str_len = command.length() + 1; 

// Prepare the character array (the buffer) 
char c[str_len];

// Copy it over 
command.toCharArray(c, str_len);
//sprintf(c,"%s",command);
Serial.print("c : ");
Serial.println(c);
   display.clearDisplay();
   drawStr(0,10,c);
  display.display();
  
command ="";
}
